## config/boards/shields/gemini/Kconfig.defconfig
```kconfig
# Copyright (c) 2020 The ZMK Contributors
# SPDX-License-Identifier: MIT

if SHIELD_GEMINI_LEFT

config ZMK_KEYBOARD_NAME
	default "Gemini"

config ZMK_SPLIT_ROLE_CENTRAL
	default y

endif

if SHIELD_GEMINI_LEFT || SHIELD_GEMINI_RIGHT

config ZMK_SPLIT
	default y

endif
```

## config/boards/shields/gemini/Kconfig.shield
```kconfig
# Copyright (c) 2020 The ZMK Contributors
# SPDX-License-Identifier: MIT

config SHIELD_GEMINI_LEFT
    def_bool $(shields_list_contains,gemini_left)

config SHIELD_GEMINI_RIGHT
    def_bool $(shields_list_contains,gemini_right)
```
